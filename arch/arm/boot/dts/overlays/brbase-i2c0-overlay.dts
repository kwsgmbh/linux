// Device tree overlay for https://kws-computer.de/produkte-2/bridgeth/base
// for details see ...

/dts-v1/;
/plugin/;

/ {
    compatible = "brcm,bcm2835";

    fragment@0 {
        target = <&i2c_arm>;
        __overlay__ {
            status = "disabled";
        };
    };

    fragment@1 {
        target-path = "/";
        __overlay__ {
            i2c0: i2c-gpio@0 {
                #address-cells = <1>;
                #size-cells = <0>;
                compatible = "i2c-gpio";
                gpios = <&gpio 44 6>, /* SDA GPIO_OPEN_DRAIN */
                        <&gpio 45 6>; /* CLK GPIO_OPEN_DRAIN */
                clock-frequency = <400000>;
                status = "okay";
            };
        };
    };
};
